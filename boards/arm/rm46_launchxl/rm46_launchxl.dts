/*
 * Copyright (c) 2019 Lexmark International, Inc.
 *
 * SPDX-License-Identifier: Apache-2.0
 *
 */

/dts-v1/;
#include <arm/ti/rm46l852.dtsi>

/ {
	model = "LaunchXL2 RM46";
	compatible = "ti,launchxl2-rm46";

	chosen {
		zephyr,sram = &sram0;
		/*zephyr,flash = &flash0;
		zephyr,console = &uart0;
		zephyr,shell-uart = &uart0;*/
	};
};

/*&uart0 {
	status = "okay";
	current-speed = <115200>;
	clock-frequency = <220000000>;
}; */


