## boards/arm/rm46_launchxl/Kconfig.board
```kconfig
# TI Hercules LaunchXL2-RM46 Development Board

# SPDX-License-Identifier: Apache-2.0

config BOARD_RM46_LAUNCHXL
	bool "TI LAUNCHXL2-RM46"
	depends on SOC_RM46L852
```

## boards/arm/rm46_launchxl/Kconfig.defconfig
```kconfig
# TI Hercules LaunchXL2-RM46 Development Board

# SPDX-License-Identifier: Apache-2.0
if BOARD_RM46_LAUNCHXL
config BOARD
	default "rm46_launchxl"
	depends on BOARD_RM46_LAUNCHXL
endif
```

## boards/arm/rm46_launchxl/rm46_launchxl_defconfig
```kconfig
# SPDX-License-Identifier: Apache-2.0

CONFIG_BOARD_RM46_LAUNCHXL=y
CONFIG_SOC_SERIES_RM46=y
CONFIG_SOC_RM46L852=y
CONFIG_SYS_CLOCK_HW_CYCLES_PER_SEC=220000000
CONFIG_FLASH_SIZE=0
CONFIG_FLASH_BASE_ADDRESS=0
# Floating point options
CONFIG_FPU=y

# enable uart driver
CONFIG_SERIAL=y

# enable console
CONFIG_CONSOLE=y
CONFIG_UART_CONSOLE=y
```

## soc/arm/ti_hercules/Kconfig
```kconfig
# Texas Instruments Hercules Family

# SPDX-License-Identifier: Apache-2.0

config SOC_FAMILY_TIHERCULES
	bool

if SOC_FAMILY_TIHERCULES

config SOC_FAMILY
	string
	default "ti_hercules"

rsource "*/Kconfig.soc"



endif # SOC_FAMILY_TIHERCULES
```

## soc/arm/ti_hercules/rm46/Kconfig.defconfig.rm46l852
```kconfig
# TI Hercules RM46L852 SoC

# Copyright (c) 2017, 2021, Alexander Bulychev <a.f.bulychev@gmail.com>
# SPDX-License-Identifier: Apache-2.0

#if SOC_RM46L852

config SOC
	default "rm46l852"

config NUM_IRQS
	default 128

#endif # SOC_RM46L852
```

## soc/arm/ti_hercules/rm46/Kconfig.defconfig.series
```kconfig
# TI Hercules RM46LXXX

# Copyright (c) 2021, Alexander Bulychev <a.f.bulychev@gmail.com>
# SPDX-License-Identifier: Apache-2.0

if SOC_SERIES_RM46

rsource "Kconfig.defconfig.rm46l*"

config SOC_SERIES
	default "rm46"

config SYS_CLOCK_HW_CYCLES_PER_SEC
    default 220000000

endif # SOC_SERIES_RM46
```

## soc/arm/ti_hercules/rm46/Kconfig.series
```kconfig
# Copyright (c) 2021 Alexander Bulychev <a.f.bulychev@gmail.com>
# SPDX-License-Identifier: Apache-2.0

config SOC_SERIES_RM46
	bool "TI Hercules RM46"
	select ARM
	select CPU_CORTEX_R4
	select GIC_V1
#	select CPU_HAS_FPU
	select SOC_FAMILY_TIHERCULES
    help
	  Enable support for TI Hercules RM46.
```

## soc/arm/ti_hercules/rm46/Kconfig.soc
```kconfig
# Texas Instruments RM46

# Copyright (c) 2021, Alexander Bulychev <a.f.bulychev@gmail.com>
# SPDX-License-Identifier: Apache-2.0

choice
	prompt "TI Hercules MCU Selection"
	depends on SOC_SERIES_RM46

config SOC_RM46L852
	bool "RM46L852"

endchoice
```
